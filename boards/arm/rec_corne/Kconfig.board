## boards/arm/rec_corne/Kconfig.board
```kconfig
#
# Copyright (c) 2024 The ZMK Contributors
# SPDX-License-Identifier: MIT
#

config BOARD_REC_CORNE_LEFT
    bool "rec_corne left"
    depends on SOC_NRF52840_QIAA

config BOARD_REC_CORNE_RIGHT
    bool "rec_corne right"
    depends on SOC_NRF52840_QIAA
```
